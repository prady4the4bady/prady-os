## build/iso/buildroot-config/kryos_defconfig
```kconfig
# Prady OS — Buildroot defconfig (x86_64)
# Phase 33: Production ISO Build
# Kernel fork: https://github.com/prady4the4bady/linux
# Generated for Prady OS v1.0.0

#
# Architecture
#
BR2_x86_64=y
BR2_X86_CPU_COREI2CORE=y
BR2_X86_CPU_HAS_SSE4=y
BR2_X86_CPU_HAS_AVX=y

#
# Build options
#
BR2_CCACHE=y
BR2_OPTIMIZE_2=y
BR2_STRIP_strip=y

#
# Toolchain
#
BR2_TOOLCHAIN_BUILDROOT_GLIBC=y
BR2_TOOLCHAIN_BUILDROOT_CXX=y
BR2_TOOLCHAIN_BUILDROOT_FORTRAN=y
BR2_ENABLE_LOCALE=y
BR2_ENABLE_NLS=y

#
# System configuration
#
BR2_TARGET_GENERIC_HOSTNAME="prady-os"
BR2_TARGET_GENERIC_ISSUE="Prady OS v1.0.0"
BR2_TARGET_GENERIC_ROOT_PASSWD_SHA256CRYPT="$5$prady$placeholder"
BR2_SYSTEM_DHCP="eth0"
BR2_SYSTEM_INIT_SYSTEMD=y
BR2_TARGET_TIMEZONE="UTC"
BR2_ROOTFS_USERS_TABLES=""

#
# Linux kernel — custom git fork
#
BR2_LINUX_KERNEL=y
BR2_LINUX_KERNEL_CUSTOM_GIT=y
BR2_LINUX_KERNEL_CUSTOM_REPO_URL="https://github.com/prady4the4bady/linux"
BR2_LINUX_KERNEL_CUSTOM_REPO_VERSION="main"
BR2_LINUX_KERNEL_DEFCONFIG="x86_64"
BR2_LINUX_KERNEL_NEEDS_HOST_OPENSSL=y
BR2_LINUX_KERNEL_NEEDS_HOST_LIBELF=y
BR2_LINUX_KERNEL_IMAGE_BZIMAGE=y
BR2_LINUX_KERNEL_DTS_SUPPORT=n

#
# Filesystem images
#
BR2_TARGET_ROOTFS_EXT2=y
BR2_TARGET_ROOTFS_EXT2_4=y
BR2_TARGET_ROOTFS_EXT2_SIZE="4G"
BR2_TARGET_ROOTFS_SQUASHFS=y
BR2_TARGET_ROOTFS_SQUASHFS_LZMA=y
BR2_TARGET_ROOTFS_ISO9660=y
BR2_TARGET_ROOTFS_ISO9660_GRUB2=y

#
# Packages — Core utilities
#
BR2_PACKAGE_BUSYBOX=y
BR2_PACKAGE_BASH=y
BR2_PACKAGE_BASH_COMPLETION=y
BR2_PACKAGE_COREUTILS=y
BR2_PACKAGE_LIBCURL=y
BR2_PACKAGE_LIBCURL_CURL=y
BR2_PACKAGE_CURL=y
BR2_PACKAGE_WGET=y
BR2_PACKAGE_GIT=y
BR2_PACKAGE_HTOP=y
BR2_PACKAGE_VIM=y
BR2_PACKAGE_TMUX=y
BR2_PACKAGE_RSYNC=y
BR2_PACKAGE_LESS=y
BR2_PACKAGE_FILE=y
BR2_PACKAGE_SUDO=y
BR2_PACKAGE_SHADOW=y
BR2_PACKAGE_UTIL_LINUX=y
BR2_PACKAGE_E2FSPROGS=y
BR2_PACKAGE_PARTED=y
BR2_PACKAGE_PROCPS_NG=y
BR2_PACKAGE_PSMISC=y
BR2_PACKAGE_LSOF=y
BR2_PACKAGE_STRACE=y

#
# Packages — Network
#
BR2_PACKAGE_OPENSSH=y
BR2_PACKAGE_OPENSSL=y
BR2_PACKAGE_IPROUTE2=y
BR2_PACKAGE_DHCPCD=y
BR2_PACKAGE_IPTABLES=y
BR2_PACKAGE_NFTABLES=y
BR2_PACKAGE_NETCAT=y
BR2_PACKAGE_SOCAT=y
BR2_PACKAGE_DNSMASQ=y

#
# Packages — Container runtime
#
BR2_PACKAGE_DOCKER_ENGINE=y
BR2_PACKAGE_DOCKER_CLI=y
BR2_PACKAGE_DOCKER_COMPOSE=y
BR2_PACKAGE_CONTAINERD=y
BR2_PACKAGE_RUNC=y

#
# Packages — Python 3
#
BR2_PACKAGE_PYTHON3=y
BR2_PACKAGE_PYTHON3_PY_LAUNCHER=y
BR2_PACKAGE_PYTHON_SETUPTOOLS=y
BR2_PACKAGE_PYTHON_PIP=y
BR2_PACKAGE_PYTHON3_DISTUTILS=y
BR2_PACKAGE_PYTHON_REQUESTS=y
BR2_PACKAGE_PYTHON_PYYAML=y

#
# Packages — Node.js
#
BR2_PACKAGE_NODEJS=y
BR2_PACKAGE_NODEJS_NPM=y

#
# Packages — Display server
#
BR2_PACKAGE_XORG7=y
BR2_PACKAGE_XSERVER_XORG_SERVER=y
BR2_PACKAGE_XDRIVER_XF86_VIDEO_FBDEV=y
BR2_PACKAGE_XDRIVER_XF86_VIDEO_VESA=y
BR2_PACKAGE_XDRIVER_XF86_VIDEO_INTEL=y
BR2_PACKAGE_XDRIVER_XF86_INPUT_EVDEV=y
BR2_PACKAGE_XDRIVER_XF86_INPUT_SYNAPTICS=y
BR2_PACKAGE_OPENBOX=y
BR2_PACKAGE_XTERM=y
BR2_PACKAGE_XCURSOR_THEMES=y
BR2_PACKAGE_XLIB_LIBXCOMPOSITE=y
BR2_PACKAGE_XLIB_LIBXRENDER=y
BR2_PACKAGE_XLIB_LIBXRANDR=y
BR2_PACKAGE_XINIT=y

#
# Packages — Browser (desktop shell kiosk host)
#
BR2_PACKAGE_CHROMIUM=y
BR2_PACKAGE_CHROMIUM_PROPRIETARY_CODECS=y

#
# Packages — Audio
#
BR2_PACKAGE_ALSA_UTILS=y
BR2_PACKAGE_ALSA_LIB=y
BR2_PACKAGE_PULSEAUDIO=y
BR2_PACKAGE_PULSEAUDIO_DAEMON=y

#
# Packages — Fonts
#
BR2_PACKAGE_LIBERATION=y
BR2_PACKAGE_DEJAVU=y
BR2_PACKAGE_FONTCONFIG=y

#
# Packages — System daemons
#
BR2_PACKAGE_DBUS=y
BR2_PACKAGE_DBUS_DAEMON=y
BR2_PACKAGE_AVAHI=y
BR2_PACKAGE_UDEV=y
BR2_PACKAGE_ACPID=y

#
# Packages — Multimedia / Voice (Phase 31)
#
BR2_PACKAGE_FFMPEG=y
BR2_PACKAGE_OPUS=y
BR2_PACKAGE_FLAC=y

#
# Bootloader
#
BR2_TARGET_GRUB2=y
BR2_TARGET_GRUB2_X86_64_EFI=y
BR2_TARGET_GRUB2_BUILTIN_MODULES_PC="boot linux ext2 fat squash4 part_msdos part_gpt normal biosdisk gfxterm png"
BR2_TARGET_GRUB2_BUILTIN_MODULES_EFI="boot linux ext2 fat squash4 part_gpt normal efi_gop gfxterm png"
BR2_TARGET_GRUB2_NEEDS_HOST_PYTHON=y
```
